/dts-v1/;
/plugin/;

/ {
	compatible = "brcm,bcm2835";

	fragment@0 {
		target-path = "/";
		__overlay__ {
			htrc110: htrc110@0 {
				compatible = "nxp,htrc110";
				din-gpios = <&gpio 24 0>;
				dout-gpios = <&gpio 23 0>;
				sclk-gpios = <&gpio 22 0>;
				cs-gpios = <&gpio 25 0>;

				interrupt-parent = <&gpio>;
				interrupts = <24 1>; // low-to-high edge triggered
			};
		};
	};
};
