// Device tree overlay for I2C connected TI INA260 precision digital current and power monitor
/dts-v1/;
/plugin/;

/ {
	compatible = "brcm,bcm2835", "brcm,bcm2708", "brcm,bcm2709";

	fragment@0 {
		target = <&i2c0>;
		__overlay__ {
			#address-cells = <1>;
			#size-cells = <0>;
			status = "okay";

			ina260: ina260@40 {
				compatible = "ti,ina260";
				reg = <0x40>;
			};
		};
	};

	__overrides__ {
		addr = <&ina260>,"reg:0";
	};
};
